## meta-vortex/meta-vortex-apps/conf/layer.conf
```bitbake
# We have a packages directory, add to BBFILES
BBPATH := "${BBPATH}:${LAYERDIR}"

BBFILES += "${LAYERDIR}/recipes-*/*/*.bb*"
BBFILES += "${LAYERDIR}/images/*.bb*"
BBFILES += "${LAYERDIR}/classes/*.bb*"

BBFILE_COLLECTIONS += "vortex-apps"
BBFILE_PATTERN_vortex-apps := "^${LAYERDIR}/"
BBFILE_PRIORITY_vortex-apps = "11"

LICENSE_PATH += "${LAYERDIR}/custom-licenses"

# Let us add layer-specific bbappends which are only applied when that
# layer is included in our configuration
BBFILES += "${@' '.join('${LAYERDIR}/recipes*/%s/*/*.bbappend' % layer \
              for layer in BBFILE_COLLECTIONS.split())}"


# Let us add layer-specific bb which are only applied when that
# layer is included in our configuration
BBFILES += "${@' '.join('${LAYERDIR}/recipes*/%s/*/*.bb' % layer \
              for layer in BBFILE_COLLECTIONS.split())}"

LAYERSERIES_COMPAT_vortex-apps = "thud"
```

## meta-vortex/meta-vortex-var-som-mx6/conf/distro/vortex-fslc-x11.conf
```bitbake
# FSLC Distro for X11 without wayland.

require conf/distro/include/fslc-base.inc

DISTRO = "vortex-fslc-x11"
DISTRO_NAME = "Vortex FSLC X11"

# Remove conflicting backends.
DISTRO_FEATURES_remove = "wayland "

# These are X11 specific
DISTRO_FEATURES_append = " x11"

DISTRO_VERSION_append = ".0"
```

## meta-vortex/meta-vortex-var-som-mx6/conf/layer.conf
```bitbake
# We have a packages directory, add to BBFILES
BBPATH := "${BBPATH}:${LAYERDIR}"

BBFILES += "${LAYERDIR}/recipes-*/*/*.bb*"
BBFILES += "${LAYERDIR}/images/*.bb*"
BBFILES += "${LAYERDIR}/classes/*.bb*"

BBFILE_COLLECTIONS += "vortex-var-som-mx6"
BBFILE_PATTERN_vortex-var-som-mx6 := "^${LAYERDIR}/"
BBFILE_PRIORITY_vortex-var-som-mx6 = "10"

LICENSE_PATH += "${LAYERDIR}/custom-licenses"

# Let us add layer-specific bbappends which are only applied when that
# layer is included in our configuration
BBFILES += "${@' '.join('${LAYERDIR}/recipes*/%s/*/*.bbappend' % layer \
              for layer in BBFILE_COLLECTIONS.split())}"


# Let us add layer-specific bb which are only applied when that
# layer is included in our configuration
BBFILES += "${@' '.join('${LAYERDIR}/recipes*/%s/*/*.bb' % layer \
              for layer in BBFILE_COLLECTIONS.split())}"

LAYERSERIES_COMPAT_vortex-var-som-mx6 = "thud"
```
